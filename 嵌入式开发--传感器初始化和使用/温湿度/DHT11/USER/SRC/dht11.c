#include "dht11.h"
#include "systick.h"
#include "string.h"
#include "stdio.h" 
/*******************************************************************************************************
**** 程序名称：   DHT11_Init
**** 设计者:      Zhangxx    日期：2018年11月09日
**** 修改者:      Zhangxx    日期：2018年11月09日
**** 功  能：	    温湿度管脚初始化
**** 版本信息:    V0.1
**** 说  明：    
****编程思路：    
****信盈达官网：  www.edu118.com   成才热线：18948782707
********************************************************************************************************/
u8 DHT11_Init(void)
{
	RCC->AHB1ENR 	|= 	1<<2;						//使能PC时钟
	GPIOC->MODER 	&= 	~(0x03<<(2*4));	//设置PC.4模式
	GPIOC->MODER 	|= 	0x01<<(2*4);		//设置PC.4为通用输出模式
	GPIOC->OTYPER &= 	~(1<<4);				//设置PC.4为推挽输出
	GPIOC->OSPEEDR &= ~(1<<(2*4));		//设置PC.4输出速度
	GPIOC->OSPEEDR |= 2<<(2*4);				//设置PC.4输出速度为50MHz
	GPIOC->PUPDR &= ~(0x01<<(2*4));		//配置PC.4上下拉
	GPIOC->PUPDR |= 1<<(2*4);					//配置PC.4为上拉模式
	GPIOC->BSRRL  = 0x01<<4;      		//PC.4输出高电平
	DHT11_Start();										//起始信号的检测
	return DHT11_Check();             //检测DHT11是否有响应
}
/*******************************************************************************************************
**** 程序名称：   DHT11_Start
**** 设计者:      Zhangxx    日期：2018年11月09日
**** 修改者:      Zhangxx    日期：2018年11月09日
**** 功  能：	    DHT11起始信号
**** 版本信息:    V0.1
**** 说  明：    
****编程思路：    
****信盈达官网：  www.edu118.com   成才热线：18948782707
********************************************************************************************************/
void DHT11_Start(void)
{
	GPIOC->MODER &= ~(0x03<<(2*4));	
	GPIOC->MODER |= 0x01<<(2*4);		//设置PC.4为通用输出模式
	DAT_H();												//拉高DAT总线
	DAT_L();												//拉低DAT总线
	Delay_ms(20);										//拉低至少18ms
	DAT_H();												//拉高DAT总线
	Delay_us(30);										//主机拉高20~40us
}
/*******************************************************************************************************
**** 程序名称：   DHT11_Check
**** 设计者:      Zhangxx    日期：2018年11月09日
**** 修改者:      Zhangxx    日期：2018年11月09日
**** 功  能：	    检测DHT11是否有响应
**** 版本信息:    V0.1
**** 说  明：    
****编程思路：    响应信号（先低电平80us后高电平80us）的检测，返回1:未检测到DHT11的存在，返回0:检测到DHT11响应
****信盈达官网：  www.edu118.com   成才热线：18948782707
********************************************************************************************************/
u8 DHT11_Check(void)
{
	u8 retry = 0;
	GPIOC->MODER &= ~(0x03<<(2*4));					//设置PG.4为输入模式
	while( (!DAT_Read()) && (retry<100) ) 	//DHT11会拉低40~80us
	{
		retry++;
		Delay_us(1);  
	};
	if( retry >= 100 ) 	return 1; 					//返回1，表示DHT11没有正常响应，或响应失败
	else retry = 0;
	while( DAT_Read() && (retry<100) )			//DHT11拉低后会再次拉高40~80us
	{
		retry++;
		Delay_us(1);
	}
	if( retry >= 100 ) 	return 1; 					//返回1，表示DHT11没有正常响应，或响应失败
	return 0; 															//返回0，表示DHT11正常响应
}
/*******************************************************************************************************
**** 程序名称：   DHT11_Read_Bit
**** 设计者:      Zhangxx    日期：2018年11月09日
**** 修改者:      Zhangxx    日期：2018年11月09日
**** 功  能：	    读取位信号
**** 版本信息:    V0.1
**** 说  明：    
****编程思路：    读取数据位 ，高电平时隙在26us-28us,表示‘0’；高电平时隙为70us左右表示‘1’
****信盈达官网：  www.edu118.com   成才热线：18948782707
********************************************************************************************************/
u8 DHT11_Read_Bit(void)
{
	u8 retry = 0;
	while( DAT_Read() && (retry<100) )		//等待变为低电平
	{
		retry++;
		Delay_us(1);
	}
	retry = 0;                            
	while( (!DAT_Read()) && (retry<100) )	//等待变为高电平，同时测量高电平时间
	{
		retry++;
		Delay_us(1);											 
	}
	Delay_us(40); 												//等待40us
	if( DAT_Read() )	return 1;  					//读取该位为1，则返回1
	else 							return 0;           //否则返回0
}
/*******************************************************************************************************
**** 程序名称：   DHT11_Read_Byte
**** 设计者:      Zhangxx    日期：2018年11月09日
**** 修改者:      Zhangxx    日期：2018年11月09日
**** 功  能：	    读取字节
**** 版本信息:    V0.1
**** 说  明：    
****编程思路：    读取一个字节，一位一位读取
****信盈达官网：  www.edu118.com   成才热线：18948782707
********************************************************************************************************/
u8 DHT11_Read_Byte(void)
{
	u8 i = 0;
	u8 data = 0;
	for(i = 0; i < 8; i++)
	{
		data <<= 1;
		data |= DHT11_Read_Bit();  //一位一位读取
	}
	return data;	       				 //返回读取到数据
}
/*******************************************************************************************************
**** 程序名称：   DHT11_Read_Data
**** 设计者:      Zhangxx    日期：2018年11月09日
**** 修改者:      Zhangxx    日期：2018年11月09日
**** 功  能：	    读取40个bit数据
**** 版本信息:    V0.1
**** 说  明：     
****编程思路：    以指针作为形参，地址传递，把获取到的温度湿度回写给调用该函数的函数空间
									正常读取数据返回0，否则返回1。humi:湿度值(范围:20%~90%)，temp:温度值(范围:0~50°)
****信盈达官网：  www.edu118.com   成才热线：18948782707
********************************************************************************************************/
u8 buf[6] = {0,0,0,0,0,'\0'}; //用来存取8bit湿度整数部分 + 8bit湿度小数部分+8bit温度整数部分+8bit温度小数部分+8bit校验和
u8 DHT11_Read_Data(float *temp,float *humi) 
{
	u8 i = 0;
	DHT11_Start();
	if(DHT11_Check() == 0)					//正常响应后
	{
		for(i = 0; i < 5; i++)				//读取40位数据
		{
			buf[i] = DHT11_Read_Byte(); //读取5个字节数据存储到数组中 
		}
		if( (buf[0]+buf[1]+buf[2]+buf[3]) == buf[4] ) //检验数据是否接收正确
		{
			*humi=buf[0] + buf[1] / 256.0;   //存储湿度值，整数和小数
			*temp=buf[2] + buf[3] / 256.0;   //存储温度值，整数和小数
		}
	}
	else return 1;									//异常响应返回1
	return 0;												//正常响应返回0
}
/*******************************************************************************************************
**** 程序名称：   DHT11_Show_Data
**** 设计者:      Zhangxx    日期：2018年11月09日
**** 修改者:      Zhangxx    日期：2018年11月09日
**** 功  能：	    显示测量到的湿度和温度
**** 版本信息:    V0.1
**** 说  明：     
****编程思路：    判断是否读取正常，然后把测量到的数据打印到串口助手
****信盈达官网：  www.edu118.com   成才热线：18948782707
********************************************************************************************************/
float  temperature = 0;
float humidity = 0;
void DHT11_Show_Data(void)
{
		if(DHT11_Read_Data(&temperature,&humidity) == 0)	//读取温湿度值
		{
			printf("温度：%f\r\n",temperature);
			printf("湿度：%f\r\n",humidity);
		}	
}




