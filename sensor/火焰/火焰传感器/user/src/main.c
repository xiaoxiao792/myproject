#include "stm32f4xx.h"
#include "led.h"
#include "hc_sr.h"
#include "key.h"
#include <stdio.h>
#include "systick.h"

/*******************************************************************************************************
**** 程序名称：   main
**** 设计者:      Zhangxx    日期：2019年5月01日
**** 修改者:      Zhangxx    日期：2019年5月01日
**** 功  能：	    检测是否有火焰靠近
**** 版本信息:    V2
**** 说  明：     
****编程思路：    如果读到火焰传感器模块是高电平则灯亮，如果是低电平，则灯灭
****信盈达官网：  www.edu118.com   成才热线：18948782707
********************************************************************************************************/
int main()
{
	u32 a;
	int i;
	int sta;
	LED_Init();
	HC_SR_init();  //火焰传感器模块管脚初始化

	
	while(1)
	{
		sta = HC_SR_input();  //读感应模块电平变化  PC1
		
		if(sta == 1)   //有火焰进入范围
		{
			LED_ON(2); //灯亮
			
		}
		else if(sta == 0)  //没有火焰进入
			LED_OFF(2);
		Delay_ms(168, 1000); 
	}
}




