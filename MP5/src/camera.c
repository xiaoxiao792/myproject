#include "camera.h"

//定义全局变量
int  cam_flag = 0 ;
/*
0 --> 摄像头实时显示
1 --> 抓拍一张照片
2 --> 退出
 */

int camera()
{	
	int ret , num;
	char file_name[15];
	struct jpg_data video_buf;
	
	//初始化LCD 
	lcd_open();

	//创建线程
	pthread_t  thread;  
	pthread_create(&thread ,	//线程ID
						 NULL ,		//线程属性 NULL 不设置特殊属性标准线程
						 func,  //线程的例程
						 NULL); //线程例程的参数

	//初始化摄像头
	linux_v4l2_yuyv_init("/dev/video7");

	//开启摄像头捕捉
	linux_v4l2_start_yuyv_capturing();
	
	
	while(1)
	{
		//获取摄像头捕捉的画面
		linux_v4l2_get_yuyv_data (&video_buf);
	
		if (0 == cam_flag)
		{
			//显示摄像头捕捉的画面
			show_video_data(80, 0, video_buf.jpg_data , video_buf.jpg_size);
		}
		
		else if (1 == cam_flag)
		{
			// printf("abc%d.jpg", num++);  snprintf()
			sprintf( file_name ,"./pic/abc%d.jpg", num++);
			//创建并打开新的文件
			int fd_jpg = open(file_name , O_RDWR | O_CREAT | O_TRUNC , 0666 );
			// if (fd_jpg = -1)
			if (-1 == fd_jpg)
			{
				perror("open abc.jpg error ");
				cam_flag = 0;
				continue ;  // 跳过后面语句重新执行while
			}
			//写入当前摄像头的数据
			ret = write(fd_jpg, video_buf.jpg_data, video_buf.jpg_size);
			printf("write:%d\n",  ret );
			//关闭文件
			close(fd_jpg);

		


			cam_flag = 0 ;
		}else if (2==cam_flag)
		{
			printf("退出");
			//摄像头解除初始化
			linux_v4l2_yuyv_quit();
			
			lcd_close();
			
			cam_flag = 0;

			return 0;
		}else if (3==cam_flag)
		{
			//显示捕捉到的照片
			lcd_draw_jpg(80,0,file_name);
			sleep(10);
			cam_flag = 0;
		}else if (4==cam_flag)
		{
			//显示捕捉到的照片
			lcd_draw_jpg(80,0,file_name);
			sleep(10);
			cam_flag = 0;
		}

	}


}


void * func(void * arg )
{
	int x , y;
	while(1)
	{
		touch(&x, &y);
		printf("%s---%d(%d,%d)\n",__FUNCTION__, __LINE__ ,x, y);
		if (x>0 && x<80 && y>0 && y<240)
		{
			/* 拍照 */
			cam_flag = 1 ;
		}
		else if (x>0 && x<80 && y>240 && y<480)
		{
			/* 返回 */
			cam_flag = 2 ;
		}else if (x>720 && x<800 && y>0 && y<240)
		{
			/* 上一张 */
			cam_flag = 3 ;
		}else if (x>720 && x<800 && y>240 && y<480)
		{
			/* 下一张 */
			cam_flag = 4 ;
		}
	}


}