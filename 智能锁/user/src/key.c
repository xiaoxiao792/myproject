#include "stm32f10x.h"                  // Device header
#include "key.h"
#include "systick.h"
 
/*******************************************************************
函数功能：按键初始化
硬件接口：
	WHUP-----PB7--------按键按下检测到高电平

*******************************************************************/
void Key_Init(void)
{
	//开启B口时钟 
	RCC->APB2ENR |= 1 << 3;
	//PB7
  GPIOB->CRL &=~(15 << 4*7);  
	GPIOB->CRL |=(8 << 4*7);
	GPIOB->ODR |= 1 << 7;//上拉  低电平有效	
}

/*******************************************************************
函数功能：按键消抖（延时）
函数返回值：1：按键按下  0：没有按键按下
********************************************************************/
u8 Key_Scan(void)
{
	static u8 flag = 0;
	if((!KEY_State) && (flag == 0))
	{
		flag = 1;
		Delay_ms(10);
		if(!KEY_State)
		{
			return 1;
		}
	}
	else if(KEY_State)
	{
		flag = 0;
	}
	return 0;
}




















































